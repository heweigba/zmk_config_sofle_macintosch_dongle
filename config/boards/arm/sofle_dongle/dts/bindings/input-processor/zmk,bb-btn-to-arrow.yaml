## config/boards/arm/sofle_dongle/dts/bindings/input-processor/zmk,bb-btn-to-arrow.yaml
```yaml
# Copyright (c) 2026 ZitaoTech
# SPDX-License-Identifier: MIT

description: BB Button to Arrow Key Input Processor

compatible: "zmk_bb_btn_to_arrow"

include: [base.yaml]

properties:
  "#input-processor-cells":
    type: int
    const: 0
```

## config/boards/arm/sofle_dongle/dts/bindings/zmk_bb_wheel_to_arrow.yaml
```yaml
# Copyright (c) 2023 ZitaoTech
# SPDX-License-Identifier: MIT

description: BB Trackball wheel-to-arrow key input processor

compatible: "zmk_bb_wheel_to_arrow"

properties:
  status:
    type: string
    required: false
  track-remainders:
    type: boolean
    required: false
```
